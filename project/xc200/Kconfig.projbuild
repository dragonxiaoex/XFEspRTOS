## project/xc200/Kconfig.projbuild
```kconfig
menu "EYE LCD Configuration(RGB)"
    choice LCD_BUFFER_MODE
        prompt "RGB LCD Buffer Mode"
        default USE_SINGLE_FB
        help
            Select the LCD buffer mode.

        config USE_SINGLE_FB
            bool "Use single frame buffer"
            help
                Allocate one frame buffer in the driver.
                Allocate one draw buffer in LVGL.

        config USE_DOUBLE_FB
            bool "Use double frame buffer"
            help
                Allocate two frame buffers in the driver.
                The frame buffers also work as ping-pong draw buffers in LVGL.

        config USE_BOUNCE_BUFFER
            bool "Use bounce buffer"
            help
                Allocate one frame buffer in the driver.
                Allocate two bounce buffers in the driver.
                Allocate one draw buffer in LVGL.
    endchoice

    config LCD_RGB_BUFFER_NUMS
            int "Set number of frame buffers"
            default 1
            range 1 3
            help
                Let RGB LCD driver create a specified number of frame-size buffers. Only when it is set to multiple can the avoiding tearing be turned on.

    config DISPLAY_LVGL_AVOID_TEAR
            bool "Avoid tearing effect"
            depends on LCD_RGB_BUFFER_NUMS > 1
            default "n"
            help
                Avoid tearing effect through LVGL buffer mode and double frame buffers of RGB LCD. This feature is only available for RGB LCD.

    choice DISPLAY_LVGL_MODE
            depends on DISPLAY_LVGL_AVOID_TEAR
            prompt "Select LVGL buffer mode"
            default DISPLAY_LVGL_FULL_REFRESH
            config DISPLAY_LVGL_FULL_REFRESH
                bool "Full refresh"
            config DISPLAY_LVGL_DIRECT_MODE
                bool "Direct mode"
    endchoice

    menu "GPIO assignment"
        config LCD_VSYNC_GPIO
            int "VSYNC GPIO"
            default 41
            help
                GPIO pin number for VSYNC signal.
        config LCD_HSYNC_GPIO
            int "HSYNC GPIO"
            default 40
            help
                GPIO pin number for HSYNC signal.
        config LCD_DE_GPIO
            int "DE GPIO"
            default 39
            help
                GPIO pin number for DE signal.
        config LCD_PCLK_GPIO
            int "PCLK GPIO"
            default 1
            help
                GPIO pin number for PCLK signal.
        config MOSI_GPIO
            int "MOSI GPIO"
            default 47
            help
                GPIO pin number for MOSI signal.
        config SCK_GPIO
            int "SCK GPIO"
            default 48
            help
                GPIO pin number for SCK signal.
        config CS_GPIO
            int "CS GPIO"
            default 45
            help
                GPIO pin number for CS signal.
        config RST_GPIO
            int "RST GPIO"
            default 0
            help
                GPIO pin number for RST signal.
        config LCD_DATA0_GPIO
            int "DATA0 GPIO"
            default 6
            help
                GPIO pin number for data bus[0].
        config LCD_DATA1_GPIO
            int "DATA1 GPIO"
            default 7
            help
                GPIO pin number for data bus[1].
        config LCD_DATA2_GPIO
            int "DATA2 GPIO"
            default 8
            help
                GPIO pin number for data bus[2].
        config LCD_DATA3_GPIO
            int "DATA3 GPIO"
            default 9
            help
                GPIO pin number for data bus[3].
        config LCD_DATA4_GPIO
            int "DATA4 GPIO"
            default 10
            help
                GPIO pin number for data bus[4].
        config LCD_DATA5_GPIO
            int "DATA5 GPIO"
            default 11
            help
                GPIO pin number for data bus[5].
        config LCD_DATA6_GPIO
            int "DATA6 GPIO"
            default 12
            help
                GPIO pin number for data bus[6].
        config LCD_DATA7_GPIO
            int "DATA7 GPIO"
            default 13
            help
                GPIO pin number for data bus[7].
        config LCD_DATA8_GPIO
            int "DATA8 GPIO"
            default 14
            help
                GPIO pin number for data bus[8].
        config LCD_DATA9_GPIO
            int "DATA9 GPIO"
            default 15
            help
                GPIO pin number for data bus[9].
        config LCD_DATA10_GPIO
            int "DATA10 GPIO"
            default 16
            help
                GPIO pin number for data bus[10].
        config LCD_DATA11_GPIO
            int "DATA11 GPIO"
            default 17
            help
                GPIO pin number for data bus[11].
        config LCD_DATA12_GPIO
            int "DATA12 GPIO"
            default 18
            help
                GPIO pin number for data bus[12].
        config LCD_DATA13_GPIO
            int "DATA13 GPIO"
            default 19
            help
                GPIO pin number for data bus[13].
        config LCD_DATA14_GPIO
            int "DATA14 GPIO"
            default 20
            help
                GPIO pin number for data bus[14].
        config LCD_DATA15_GPIO
            int "DATA15 GPIO"
            default 21
            help
                GPIO pin number for data bus[15].
    endmenu
endmenu
```
